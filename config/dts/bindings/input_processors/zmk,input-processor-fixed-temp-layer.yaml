## config/dts/bindings/input_processors/zmk,input-processor-fixed-temp-layer.yaml
```yaml
description: Input processor that enables a layer for a fixed duration on non-zero input

compatible: "zmk,input-processor-fixed-temp-layer"

include: ip_two_param.yaml
```

## config/west.yml
```yaml
manifest:
  remotes:
    - name: zmkfirmware
      url-base: https://github.com/zmkfirmware
    - name: badjeff
      url-base: https://github.com/badjeff
    - name: hsgw
      url-base: https://github.com/hsgw
    - name: caksoylar  # <-- led
      url-base: https://github.com/caksoylar
    - name: zettaface
      url-base: https://github.com/zettaface
    - name: oleksandrmaslov
      url-base: https://github.com/oleksandrmaslov
    - name: s-hiraoku
      url-base: https://github.com/s-hiraoku

  projects:
    # ZMK 本体。公式の app/west.yml を取り込む
    - name: zmk
      remote: zmkfirmware
      revision: v0.3
      import: app/west.yml

    # 再現性のため、ブランチ追従だった外部モジュールはコミット SHA に固定
    # (2026-07-04 時点)。更新したい時は SHA を手動で進める。

    # PMW3610 ドライバ（外部モジュール）。元: zmk-0.3 ブランチ
    - name: zmk-pmw3610-driver
      remote: badjeff
      revision: 5c5af40de4d8cdf55dc63c4c5907af1e52da6a95

    # Sensor-rotation。元: main ブランチ
    - name: zmk-feature-sensor_rotation
      remote: hsgw
      revision: e1a0186220ade99220d04dadf9735b758cfdf086

    # LED
    - name: zmk-rgbled-widget  # <-- led
      remote: caksoylar
      revision: v0.3

    # Trackball keybind processor
    # フォーク (non-blocking-wait ブランチ): wait-ms の k_sleep による
    # ワークキューのブロックと、wait-ms 窓での 2 連発を修正。
    # 詳細は docs/trackball-tuning.md
    - name: zmk-input-processor-keybind
      remote: s-hiraoku
      revision: 11cfe0c939e33a8c6df9ad593e0ab7129365ac8c

    # Trackball acceleration。元: main ブランチ
    - name: zmk-pointing-acceleration
      remote: oleksandrmaslov
      revision: 0da8f97f8f2abb18fcc9d488b25357511922cf32
      
  self:
    path: config
```
